## conf/layer.conf
```bitbake
# We have a conf and classes directory, add to BBPATH
BBPATH .= ":${LAYERDIR}"

# We have recipes-* directories, add to BBFILES
BBFILES += "${LAYERDIR}/recipes-*/*/*.bb \
            ${LAYERDIR}/recipes-*/*/*.bbappend"

BBFILE_COLLECTIONS += "meta-gumstix-rt"
BBFILE_PATTERN_meta-gumstix-rt := "^${LAYERDIR}/"
BBFILE_PRIORITY_meta-gumstix-rt = "6"
```
